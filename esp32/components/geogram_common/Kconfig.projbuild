## esp32/components/geogram_common/Kconfig.projbuild
```kconfig
menu "Geogram Board Selection"

    choice GEOGRAM_BOARD
        prompt "Geogram board model"
        default GEOGRAM_BOARD_EPAPER_1IN54

        config GEOGRAM_BOARD_EPAPER_1IN54
            bool "ESP32-S3 ePaper 1.54 (Waveshare)"
            depends on IDF_TARGET_ESP32S3

        config GEOGRAM_BOARD_HELTEC_V3
            bool "Heltec WiFi LoRa 32 V3"
            depends on IDF_TARGET_ESP32S3

        config GEOGRAM_BOARD_ESP32C3_MINI
            bool "ESP32-C3 Mini"
            depends on IDF_TARGET_ESP32C3

        config GEOGRAM_BOARD_GENERIC
            bool "Generic ESP32"
            depends on IDF_TARGET_ESP32

    endchoice

endmenu
```
